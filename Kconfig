## Kconfig
```kconfig
if ZMK_POINTING

config ZMK_INPUT_PROCESSOR_VERTICAL_SCROLL
    bool "Vertical-only scroll input processor"
    default y
    depends on DT_HAS_ZMK_INPUT_PROCESSOR_VERTICAL_SCROLL_ENABLED

endif

DT_COMPAT_CORCELL_BATTERY_VOLTAGE_DIVIDER := corcell,battery-voltage-divider

config CORCELL_BATTERY_VOLTAGE_DIVIDER
    bool
    default $(dt_compat_enabled,$(DT_COMPAT_CORCELL_BATTERY_VOLTAGE_DIVIDER))
    select ADC
    select ZMK_BATTERY
    depends on SENSOR
    help
        Enable Corcell dry-cell voltage divider battery monitoring.
```

## boards/shields/Corchibi2/Kconfig.defconfig
```kconfig
if SHIELD_CORCHIBI2_R

config ZMK_KEYBOARD_NAME
    default "Corchibi2"

config ZMK_SPLIT
    default y

config ZMK_SPLIT_ROLE_CENTRAL
    default y

endif

if SHIELD_CORCHIBI2_L

config ZMK_KEYBOARD_NAME
    default "Corchibi2"

config ZMK_SPLIT
    default y

endif
```

## boards/shields/Corchibi2/Kconfig.shield
```kconfig
config SHIELD_CORCHIBI2_R
    def_bool $(shields_list_contains,Corchibi2_R)

config SHIELD_CORCHIBI2_L
    def_bool $(shields_list_contains,Corchibi2_L)
```

## boards/shields/corcell/Kconfig.defconfig
```kconfig
if SHIELD_CORCELL_R

config ZMK_KEYBOARD_NAME
    default "Corcell"

config ZMK_SPLIT
    default y

config ZMK_SPLIT_ROLE_CENTRAL
    default y

endif

if SHIELD_CORCELL_L

config ZMK_KEYBOARD_NAME
    default "Corcell"

config ZMK_SPLIT
    default y

endif
```

## boards/shields/corcell/Kconfig.shield
```kconfig
config SHIELD_CORCELL_R
    def_bool $(shields_list_contains,corcell_r)

config SHIELD_CORCELL_L
    def_bool $(shields_list_contains,corcell_l)
```

## config/west.yml
```yaml
manifest:
  version: 1.2
  defaults:
    remote: cormoran
    revision: main
  remotes:
    - name: cormoran
      url-base: https://github.com/cormoran
    - name: zmkfirmware
      url-base: https://github.com/zmkfirmware
    - name: sekigon-gonnoc
      url-base: https://github.com/sekigon-gonnoc
    - name: nykxx
      url-base: https://github.com/nykxx
  projects:
    - name: zmk-west-commands
      import: true
    - name: zmk-driver-paw3222
      remote: sekigon-gonnoc
      revision: df652881be2520bde4f64ab6ca35e4c5708f4f9b
    - name: zmk-driver-azoteq-iqs5xx
      remote: nykxx
      revision: 27321f0232b50f0af31eb27ff97d539933467ea4
    - name: zmk-feature-module-physical-layout
    - name: zmk
      revision: main+dya
      import:
        file: app/west.yml
    - name: zephyr
      revision: v4.1.0+zmk-fixes+nrf-half-duplex-uart
      clone-depth: 1
      import:
        name-blocklist:
          - ci-tools
          - hal_altera
          - hal_cypress
          - hal_infineon
          - hal_microchip
          - hal_nxp
          - hal_openisa
          - hal_silabs
          - hal_xtensa
          - hal_st
          - hal_ti
          - loramac-node
          - mcuboot
          - mcumgr
          - net-tools
          - openthread
          - edtt
          - trusted-firmware-m
  self:
    path: config
```

## dts/bindings/sensor/corcell,battery-voltage-divider.yaml
```yaml
# Copyright (c) 2020 The ZMK Contributors
# Copyright (c) 2026 The Corcell contributors
# SPDX-License-Identifier: MIT

description: Corcell dry-cell battery SoC monitoring using a voltage divider

compatible: "corcell,battery-voltage-divider"

include: voltage-divider.yaml

properties:
  mv-to-pct-thresholds:
    type: array
    required: true
    description: |
      Battery millivolt thresholds for 0%, 10%, ... 100% state-of-charge
      mapping.
```

## dts/bindings/sensor/corchibi2,battery-voltage-divider.yaml
```yaml
# Copyright (c) 2020 The ZMK Contributors
# Copyright (c) 2026 The Corchibi2 contributors
# SPDX-License-Identifier: MIT

description: Corchibi2 dry-cell battery SoC monitoring using a voltage divider

compatible: "corchibi2,battery-voltage-divider"

include: voltage-divider.yaml

properties:
  mv-to-pct-thresholds:
    type: array
    required: true
    description: |
      Battery millivolt thresholds for 0%, 10%, ... 100% state-of-charge
      mapping.
```
