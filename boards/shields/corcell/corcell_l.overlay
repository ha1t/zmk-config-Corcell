#include "corcell.dtsi"

&kscan0 {
    compatible = "zmk,kscan-gpio-charlieplex";
    gpios
        = <&gpio0 3 (GPIO_ACTIVE_HIGH)>
        , <&gpio0 28 (GPIO_ACTIVE_HIGH)>
        , <&gpio0 29 (GPIO_ACTIVE_HIGH)>
        , <&gpio1 11 (GPIO_ACTIVE_HIGH)>
        , <&gpio1 15 (GPIO_ACTIVE_HIGH)>
        , <&gpio1 14 (GPIO_ACTIVE_HIGH)>
        ;
    interrupt-gpios = <&gpio1 13 (GPIO_ACTIVE_HIGH | GPIO_PULL_DOWN)>;
};
